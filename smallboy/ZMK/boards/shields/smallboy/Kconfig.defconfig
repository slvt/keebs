## trackball/ZMK/drivers/boot_button/Kconfig
```kconfig
config TRACKBALL_BOOT_BUTTON
    bool "Enter the bootloader when the left button is held at power up"
    default y if SHIELD_TRACKBALL_WIRELESS || SHIELD_TRACKBALL_WIRELESS_LEFT
    help
      Reads the first button of the trackball_buttons kscan right after boot. If it
      is held, the board reboots into the UF2 bootloader. Needs the nRF52 UF2
      bootloader of the nice!nano, and does nothing if the firmware cannot start.
```

## trackball/ZMK/drivers/input/Kconfig
```kconfig
# Copyright (c) 2025 George Norton
# SPDX-License-Identifier: MIT
#
# PMW3360 and PMW3389 optical mouse sensor driver

menuconfig INPUT_PIXART_PMW33XX
    bool "PMW3360 and PMW3389 optical mouse sensors"
    default y
    select GPIO
    select SPI
    depends on INPUT
    depends on DT_HAS_PIXART_PMW3360_ENABLED || DT_HAS_PIXART_PMW3389_ENABLED
    help
      Enable the PMW3360 and PMW3389 optical mouse sensor driver.

config INPUT_PIXART_PMW33XX_USE_OWN_THREAD
    bool "Create a thread for the PMW33XX driver."
    default y

config INPUT_PIXART_PMW33XX_THREAD_PRIORITY
    int "The priority of the PMW33XX driver thread."
    depends on INPUT_PIXART_PMW33XX_USE_OWN_THREAD
    default 5

config INPUT_PIXART_PMW33XX_THREAD_STACK_SIZE
    int "The stack size of the PMW33XX driver thread."
    depends on INPUT_PIXART_PMW33XX_USE_OWN_THREAD
    default 768
```

## trackball/ZMK/drivers/persist/Kconfig
```kconfig
# Remember the DPI step of the trackball across power cycles.

config TRACKBALL_PERSIST
    bool "Persist the trackball DPI step"
    default y if SHIELD_TRACKBALL_WIRELESS || SHIELD_TRACKBALL_WIRELESS_LEFT
    select SETTINGS
    help
      Watches the layers of the trackball_wireless keymap, saves the active DPI
      step to flash and restores it at boot.

config TRACKBALL_PERSIST_SAVE_DELAY_MS
    int "Delay before a changed state is written to flash, in ms"
    depends on TRACKBALL_PERSIST
    default 2000
    help
      A change is written once the layers have been stable for this long, so a
      quick series of presses costs one flash write, and a short delay keeps the
      value from being lost when the trackball is switched off right after.
```

## trackball/ZMK/dts/bindings/input/pixart,pmw3360.yaml
```yaml
# Copyright (c) 2025 The ZMK Contributors
# SPDX-License-Identifier: MIT
description: |
  Sensor driver for the pixart PMW3360 optical mouse sensor

compatible: "pixart,pmw3360"

include: pmw33xx-base.yaml
```

## trackball/ZMK/dts/bindings/input/pixart,pmw3389.yaml
```yaml
# Copyright (c) 2025 The ZMK Contributors
# SPDX-License-Identifier: MIT
description: |
  Sensor driver for the pixart PMW3389 optical mouse sensor

compatible: "pixart,pmw3389"

include: pmw33xx-base.yaml
```

## trackball/ZMK/dts/bindings/input/pmw33xx-base.yaml
```yaml
# Copyright (c) 2025 George Norton
# SPDX-License-Identifier: MIT
#
# Properties shared by the PMW3360 and PMW3389 bindings. Based on
# https://github.com/george-norton/zmk-driver-pmw3360

include: spi-device.yaml

properties:
  irq-gpios:
    type: phandle-array
    required: true
    description: "The GPIO which has the motion pin wired to it."
  reset-gpios:
    type: phandle-array
    description: "The GPIO which is wired to the reset pin, not used if not specifed."
  cpi:
    type: int
    default: 800
    description: |
      CPI value. PMW3360: 100 to 12000 in steps of 100.
      PMW3389: 50 to 16000 in steps of 50.
  report-interval-ms:
    type: int
    default: 8
    description: |
      Minimum time between two motion reports, in milliseconds. The motion
      interrupt is held off for this long after every report, so the sensor
      adds up the movement and one report carries the sum. Over Bluetooth this
      stops the radio from being flooded with tiny reports. 0 turns the limit
      off and sends a report per sensor read.
  rotate-90:
    type: boolean
    description: "PMW3360 only. The sensor is installed rotated 90 degrees. Rotation properties are mutually exclusive."
  rotate-180:
    type: boolean
    description: "PMW3360 only. The sensor is installed rotated 180 degrees. Rotation properties are mutually exclusive."
  rotate-270:
    type: boolean
    description: "PMW3360 only. The sensor is installed rotated 270 degrees. Rotation properties are mutually exclusive."
  angle-tune:
    type: int
    default: 0
    description: "Adjust the sensor angle in degrees (Range: -30 - 30)."
  lift-height-3mm:
    type: boolean
    description: "Configure the lift-off height to be 3mm rather than the default 2mm."
  invert-x:
    type: boolean
    description: "If true, invert the X axis."
  invert-y:
    type: boolean
    description: "If true, invert the Y axis."
```
